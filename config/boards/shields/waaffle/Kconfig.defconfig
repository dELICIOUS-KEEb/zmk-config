## config/boards/shields/waaffle/Kconfig.defconfig
```kconfig
# Copyright (c) 2020 dELLIKEEb
# SPDX-License-Identifier: MIT

if SHIELD_WAAFFLE_REV3

config ZMK_KEYBOARD_NAME
	default "waaffle rev3"

endif
```
